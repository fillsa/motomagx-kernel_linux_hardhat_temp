## linux-2.6.x/net/xfrm/Kconfig
```kconfig
#
# XFRM configuration
#
config XFRM
       bool
       depends on NET

config XFRM_USER
	tristate "Transformation user configuration interface"
	depends on INET && XFRM
	---help---
	  Support for IPsec user configuration interface used
	  by native Linux tools.

	  If unsure, say Y.

config NET_KEY
	tristate "PF_KEY sockets"
	select XFRM
	---help---
	  PF_KEYv2 socket family, compatible to KAME ones.
	  They are required if you are going to use IPsec tools ported
	  from KAME.

	  Say Y unless you know what you are doing.

config XFRM_ENHANCEMENT
	bool "Enhanced transformation (EXPERIMENTAL)"
	depends on INET	&& XFRM && EXPERIMENTAL
	---help---
	  Support for enhanced transformation.

	  If you want to use Mobile IPv6, say Y.

config XFRM_DEBUG
       bool "Transformation Debug Message"
       depends on XFRM_ENHANCEMENT
	---help---
	  You can say Y here if you want to get additional messages 
	  useful in debugging transformation code.
```
